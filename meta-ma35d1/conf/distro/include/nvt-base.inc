## meta-ma35d1/conf/distro/include/nvt-base.inc
```bitbake
# ma35d1 DISTRO for the FrameBuffer graphical backend.
MAINTAINER = "Nuvoton <www.nuvoton.com>"
DISTRO = "nvt-ma35d1"
DISTRO_NAME = "Nuvoton Release Distro"
DISTRO_CODENAME = "scarthgap"
DISTRO_VERSION = "5.0-scarthgap"
SDK_VENDOR = "-pokysdk"
SDK_VERSION := "${DISTRO_VERSION}"
TARGET_VENDOR = "-poky"
TARGET_FPU = "hard"
BUILD_64BIT_KERNEL = "1"
require conf/multilib.conf
MULTILIBS ?= "multilib:lib64"
DEFAULTTUNE:virtclass-multilib-lib64 = "armv8a"
PREFERRED_PROVIDER:udev = "systemd"
PREFERRED_PROVIDER:udev-utils = "systemd"
INIT_MANAGER = "systemd"
DISTRO_FEATURES ?= "gc520 alsa vc8000 directfb dcultrafb"
CORE_IMAGE_EXTRA_INSTALL += " ${@bb.utils.contains('KERNEL_DEFCONFIG', 'ma35d1_drm_defconfig', '', 'dcultrafb', d)} "
```
